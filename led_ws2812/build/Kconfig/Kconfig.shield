## led_ws2812/build/Kconfig/Kconfig.shield
```kconfig
osource "/Users/philipczymmek/projects/personal/31536000SecondsChallange/led_ws2812/boards/shields/*/Kconfig.shield"
osource "/opt/nordic/ncs/v2.2.0/nrf/boards/shields/*/Kconfig.shield"
```

## led_ws2812/build/Kconfig/Kconfig.shield.defconfig
```kconfig
osource "/Users/philipczymmek/projects/personal/31536000SecondsChallange/led_ws2812/boards/shields/*/Kconfig.defconfig"
osource "/opt/nordic/ncs/v2.2.0/nrf/boards/shields/*/Kconfig.defconfig"
```
